## config/west.yml
```yaml
manifest:
  defaults:
    revision: v0.3
  remotes:
    - name: zmkfirmware
      url-base: https://github.com/zmkfirmware
    - name: teenageninja637-ai #new entry
      url-base: https://github.com/teenageninja637-ai #new entry
  projects:
    - name: zmk
      remote: zmkfirmware
      import: app/west.yml
    - name: nice-shield-base #new entry
      remote: teenageninja637-ai #new entry
      revision: main #new entry
  self:
    path: config
```
